## meta-rpi-mqtt/conf/layer.conf
```bitbake
BBPATH .= ":${LAYERDIR}"

BBFILES += "${LAYERDIR}/recipes-*/*/*.bb \
             ${LAYERDIR}/recipes-*/*/*.bbappend"

BBFILE_COLLECTIONS += "rpi-mqtt"
BBFILE_PATTERN_rpi-mqtt = "^${LAYERDIR}/"
BBFILE_PRIORITY_rpi-mqtt = "6"

LAYERVERSION_rpi-mqtt = "1"
LAYERDEPENDS_rpi-mqtt = "core openembedded-layer networking-layer"
LAYERSERIES_COMPAT_rpi-mqtt = "kirkstone scarthgap"
```
